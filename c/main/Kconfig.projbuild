## c/main/Kconfig.projbuild
```kconfig
menu "Monitor ESP32"

config MONITOR_WOKWI_SIMULATION
    bool "Build the Wokwi simulation profile"
    default n
    help
        Connect to Wokwi-GUEST, use a fixed test GPS position, and do not start
        the Wi-Fi setup access point. Leave disabled for the physical ESP32.

endmenu
```

## c/sdkconfig.defaults
```kconfig
CONFIG_IDF_TARGET="esp32"
CONFIG_MBEDTLS_CERTIFICATE_BUNDLE=y
CONFIG_MBEDTLS_CERTIFICATE_BUNDLE_DEFAULT_FULL=y
CONFIG_PARTITION_TABLE_SINGLE_APP_LARGE=y
```

## rust/sdkconfig.defaults
```kconfig
CONFIG_BT_ENABLED=y
CONFIG_BT_NIMBLE_ENABLED=y
CONFIG_BT_NIMBLE_GATT_SERVER=y
CONFIG_BT_NIMBLE_ROLE_PERIPHERAL=y
CONFIG_BT_NIMBLE_MAX_CONNECTIONS=1
CONFIG_BT_NIMBLE_ROLE_CENTRAL=n
CONFIG_BT_NIMBLE_ROLE_OBSERVER=n
CONFIG_BT_NIMBLE_GATT_CLIENT=n
CONFIG_BT_NIMBLE_SECURITY_ENABLE=n
CONFIG_BT_NIMBLE_LOG_LEVEL_WARNING=y
CONFIG_ESP_WIFI_IRAM_OPT=n
CONFIG_ESP_WIFI_RX_IRAM_OPT=n
CONFIG_IDF_TARGET="esp32s3"
CONFIG_ESPTOOLPY_FLASHSIZE_16MB=y
CONFIG_SPIRAM=y
CONFIG_SPIRAM_MODE_OCT=y
CONFIG_SPIRAM_TYPE_AUTO=y
```
